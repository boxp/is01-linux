## configs/buildroot/is01_phase2_defconfig
```kconfig
BR2_arm=y
BR2_arm926t=y
BR2_ARM_EABI=y
BR2_TOOLCHAIN_BUILDROOT=y
BR2_TOOLCHAIN_BUILDROOT_UCLIBC=y
BR2_KERNEL_HEADERS_VERSION=y
BR2_DEFAULT_KERNEL_VERSION="2.6.29"
BR2_PACKAGE_HOST_LINUX_HEADERS_CUSTOM_REALLY_OLD=y
BR2_STATIC_LIBS=y
BR2_TARGET_GENERIC_HOSTNAME="is01"
BR2_TARGET_GENERIC_ISSUE="IS01 Phase 2 Buildroot userspace"
BR2_TARGET_GENERIC_GETTY_PORT="tty1"
BR2_TARGET_GENERIC_GETTY_TERM="linux"
BR2_TARGET_GENERIC_REMOUNT_ROOTFS_RW=y
BR2_ROOTFS_DEVICE_CREATION_STATIC=y
BR2_ROOTFS_STATIC_DEVICE_TABLE="system/device_table.txt board/is01/phase2/device_table.txt"
BR2_ROOTFS_OVERLAY="board/is01/phase2/rootfs-overlay"
BR2_ROOTFS_POST_BUILD_SCRIPT="board/is01/phase2/post-build.sh"
BR2_PACKAGE_BUSYBOX=y
BR2_PACKAGE_DROPBEAR=y
BR2_PACKAGE_DROPBEAR_CLIENT=y
BR2_PACKAGE_DROPBEAR_DISABLE_REVERSEDNS=y
BR2_PACKAGE_DROPBEAR_SMALL=y
BR2_TARGET_ROOTFS_CPIO=y
BR2_TARGET_ROOTFS_CPIO_NONE=y
# BR2_TARGET_ROOTFS_TAR is not set
```
